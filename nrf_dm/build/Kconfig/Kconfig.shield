## nrf_dm/build/Kconfig/Kconfig.shield
```kconfig
osource "c:/Users/ahmed/Documents/Wizense/nrf_dm/boards/shields/*/Kconfig.shield"
osource "C:/ncs/v2.2.0-rc1/nrf/boards/shields/*/Kconfig.shield"
```

## nrf_dm/build/Kconfig/Kconfig.shield.defconfig
```kconfig
osource "c:/Users/ahmed/Documents/Wizense/nrf_dm/boards/shields/*/Kconfig.defconfig"
osource "C:/ncs/v2.2.0-rc1/nrf/boards/shields/*/Kconfig.defconfig"
```
